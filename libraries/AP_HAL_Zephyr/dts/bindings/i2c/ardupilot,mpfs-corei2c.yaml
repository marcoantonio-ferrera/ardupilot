## libraries/AP_HAL_Zephyr/dts/bindings/i2c/ardupilot,mpfs-corei2c.yaml
```yaml
#
# Copyright (c) 2023 Microchip Technology Inc.
#
# SPDX-License-Identifier: Apache-2.0
#

description: Microchip CoreI2C fabric I2C controller (ArduPilot fork, same register map as MSS I2C)

compatible: "ardupilot,mpfs-corei2c"

include: [i2c-controller.yaml, reset-device.yaml]

properties:
  reg:
    required: true

  interrupts:
    required: true

  clock-frequency:
    description: 400000 selects BCLK_DIV_8 (SCL = BCLK/8, ~390 kHz)
    enum: [100000, 400000]
```

## libraries/AP_HAL_Zephyr/dts/bindings/ipm/microchip,miv-ihc-rtl-v2.yaml
```yaml
# Copyright (c) 2024 Microchip Technology Inc
# SPDX-License-Identifier: (GPL-2.0 OR MIT)

description: Microchip IHC (Inter Hart Communication) mailbox controller

compatible: "microchip,miv-ihc-rtl-v2"

include: base.yaml

properties:
  reg:
    type: array
    description: Address and length of the register set for the device
    required: true

  interrupts-parent:
    type: phandle

child-binding:
  description: IHCM (Inter Hart Communication Module) node

  properties:
    reg:
      type: array
      required: true

    interrupts:
      type: array
      required: true

  child-binding:
    description: IHCC (Inter Hart Communication Channel) node

    properties:
      reg:
        type: array
        required: true
```
